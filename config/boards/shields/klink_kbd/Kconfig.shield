## config/boards/shields/klink_kbd/Kconfig.shield
```kconfig
# Copyright (c) 2020 The ZMK Contributors
# SPDX-License-Identifier: MIT

config SHIELD_TOFU_TKL_BLE_V3_ANSI_7U
    def_bool $(shields_list_contains,tofu_tkl_iso_7u)
    select SPI
```

## zmk/app/dts/bindings/zmk,physical-layout.yaml
```yaml
properties:
  transform:
    required: true
    type: phandle
  zmk,studio-supported:
    required: false
    type: boolean
```

## zmk/app/dts/bindings/zmk/zmk,physical-layout.yaml
```yaml
description: "ZMK physical layout node binding"
compatible:
  - zmk,physical-layout

properties:
  transform:
    type: phandle
    description: "Matrix transform for the layout"

  zmk,studio-supported:
    type: boolean
    description: "Enables ZMK Studio support for this layout"
```
